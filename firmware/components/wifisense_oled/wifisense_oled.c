/*
 * SSD1306 128x64 over I2C with the ESP-IDF i2c_master driver. See wifisense_oled.h.
 */
#include <string.h>

#include "driver/i2c_master.h"
#include "esp_log.h"
#include "wifisense_oled.h"

#define W 128
#define H 64
#define I2C_HZ 400000
#define TIMEOUT_MS 50

static const char *TAG = "oled";
static i2c_master_dev_handle_t s_dev;
static bool s_ok;
static uint8_t s_fb[W * H / 8];

/* Classic 5x7 font, ASCII 0x20..0x7E, one byte per column, least significant bit at the top. */
static const uint8_t FONT[95][5] = {
    {0x00,0x00,0x00,0x00,0x00},{0x00,0x00,0x5F,0x00,0x00},{0x00,0x07,0x00,0x07,0x00},{0x14,0x7F,0x14,0x7F,0x14},
    {0x24,0x2A,0x7F,0x2A,0x12},{0x23,0x13,0x08,0x64,0x62},{0x36,0x49,0x55,0x22,0x50},{0x00,0x05,0x03,0x00,0x00},
    {0x00,0x1C,0x22,0x41,0x00},{0x00,0x41,0x22,0x1C,0x00},{0x14,0x08,0x3E,0x08,0x14},{0x08,0x08,0x3E,0x08,0x08},
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    {0x00,0x00,0x7F,0x00,0x00},{0x00,0x41,0x36,0x08,0x00},{0x10,0x08,0x08,0x10,0x08},
};

static bool cmds(const uint8_t *c, size_t n)
{
    uint8_t buf[32];
    if (n + 1 > sizeof(buf)) {
        return false;
    }
    buf[0] = 0x00;                       /* control byte: commands follow */
    memcpy(buf + 1, c, n);
    return i2c_master_transmit(s_dev, buf, n + 1, TIMEOUT_MS) == ESP_OK;
}

/* Opens an I2C bus on the two pins and looks for an SSD1306 (0x3C, then 0x3D). On success the bus stays open. */
static int try_pins(int sda_gpio, int scl_gpio, i2c_master_bus_handle_t *out)
{
    i2c_master_bus_handle_t bus;
    i2c_master_bus_config_t bus_cfg = {
        .i2c_port = -1,
        .sda_io_num = sda_gpio,
        .scl_io_num = scl_gpio,
        .clk_source = I2C_CLK_SRC_DEFAULT,
        .glitch_ignore_cnt = 7,
        .flags.enable_internal_pullup = true,   /* the module has its own pull-ups; these only help */
    };
    if (i2c_new_master_bus(&bus_cfg, &bus) != ESP_OK) {
        return -1;
    }
    int addr = -1;
    if (i2c_master_probe(bus, 0x3C, 5) == ESP_OK) {
        addr = 0x3C;
    } else if (i2c_master_probe(bus, 0x3D, 5) == ESP_OK) {
        addr = 0x3D;
    }
    if (addr < 0) {
        i2c_del_master_bus(bus);
    } else {
        *out = bus;
    }
    return addr;
}

/* GPIOs that are safe to probe on the ESP32-S3-WROOM-1U-N16R8: not strapping (0/3/45/46), USB (19/20), flash/PSRAM
 * (26-37) or the console UART (43/44). */
static const int SAFE_GPIO[] = {1, 2, 4, 5, 6, 7, 8, 9, 10, 11, 12, 13, 14, 15, 16, 17, 18, 21, 38, 39, 40, 41, 42, 47, 48};

bool oled_init(int sda_gpio, int scl_gpio)
{
    i2c_master_bus_handle_t bus;
    int addr = try_pins(sda_gpio, scl_gpio, &bus);
    if (addr < 0 && (addr = try_pins(scl_gpio, sda_gpio, &bus)) >= 0) {
        ESP_LOGW(TAG, "display found with SDA and SCL SWAPPED (SDA=%d SCL=%d); using it, but swap the two wires to match the guide",
                 scl_gpio, sda_gpio);
        int t = sda_gpio;
        sda_gpio = scl_gpio;
        scl_gpio = t;
    }
    if (addr < 0) {
        /* Not where it should be: look on every safe pin pair, so a wire on the wrong pin is reported instead of guessed. */
        const int n = sizeof(SAFE_GPIO) / sizeof(SAFE_GPIO[0]);
        for (int i = 0; i < n && addr < 0; i++) {
            for (int j = 0; j < n && addr < 0; j++) {
                if (i != j && (addr = try_pins(SAFE_GPIO[i], SAFE_GPIO[j], &bus)) >= 0) {
                    sda_gpio = SAFE_GPIO[i];
                    scl_gpio = SAFE_GPIO[j];
                    ESP_LOGW(TAG, "display found on SDA=GPIO%d SCL=GPIO%d instead of the configured pins; using it", sda_gpio, scl_gpio);
                }
            }
        }
    }
    if (addr < 0) {
        ESP_LOGW(TAG, "no SSD1306 answered on ANY safe pin pair: the display has no power or no contact (check VDD on 3V3, GND, "
                      "that the OLED's header pins are soldered and every wire shares a breadboard row with its pin)");
        return false;
    }
    i2c_device_config_t dev_cfg = {
        .dev_addr_length = I2C_ADDR_BIT_LEN_7,
        .device_address = (uint16_t)addr,
        .scl_speed_hz = I2C_HZ,
    };
    if (i2c_master_bus_add_device(bus, &dev_cfg, &s_dev) != ESP_OK) {
        return false;
    }
    static const uint8_t init1[] = {0xAE, 0xD5, 0x80, 0xA8, 0x3F, 0xD3, 0x00, 0x40, 0x8D, 0x14, 0x20, 0x00};
    static const uint8_t init2[] = {0xA1, 0xC8, 0xDA, 0x12, 0x81, 0xCF, 0xD9, 0xF1, 0xDB, 0x40, 0xA4, 0xA6, 0xAF};
    s_ok = cmds(init1, sizeof(init1)) && cmds(init2, sizeof(init2));
    if (s_ok) {
        ESP_LOGI(TAG, "SSD1306 found at 0x%02X (SDA=%d SCL=%d)", addr, sda_gpio, scl_gpio);
        oled_clear();
        oled_flush();
    }
    return s_ok;
}

bool oled_present(void)
{
    return s_ok;
}

void oled_clear(void)
{
    memset(s_fb, 0, sizeof(s_fb));
}

static void glyph(int x, int page, char ch, int scale)
{
    if (ch < 0x20 || ch > 0x7E) {
        ch = '?';
    }
    const uint8_t *g = FONT[ch - 0x20];
    for (int c = 0; c < 5; c++) {
        for (int bit = 0; bit < 7; bit++) {
            if (!(g[c] & (1 << bit))) {
                continue;
            }
            for (int dx = 0; dx < scale; dx++) {
                for (int dy = 0; dy < scale; dy++) {
                    int px = x + c * scale + dx, py = page * 8 + bit * scale + dy;
                    if (px >= 0 && px < W && py >= 0 && py < H) {
                        s_fb[(py / 8) * W + px] |= (uint8_t)(1 << (py % 8));
                    }
                }
            }
        }
    }
}

void oled_text(int row, int col, const char *s)
{
    for (int x = col * 6; s && *s && x <= W - 5; s++, x += 6) {
        glyph(x, row, *s, 1);
    }
}

void oled_text_big(int row, int col, const char *s)
{
    for (int x = col * 12; s && *s && x <= W - 10; s++, x += 12) {
        glyph(x, row, *s, 2);
    }
}

void oled_hline(int row)
{
    if (row < 0 || row > 7) {
        return;
    }
    for (int x = 0; x < W; x++) {
        s_fb[row * W + x] |= 0x08;
    }
}

void oled_flush(void)
{
    if (!s_ok) {
        return;
    }
    static const uint8_t window[] = {0x21, 0x00, 0x7F, 0x22, 0x00, 0x07};
    if (!cmds(window, sizeof(window))) {
        return;
    }
    static uint8_t out[1 + sizeof(s_fb)];
    out[0] = 0x40;                       /* control byte: display data follows */
    memcpy(out + 1, s_fb, sizeof(s_fb));
    i2c_master_transmit(s_dev, out, sizeof(out), 200);
}
